#define RST 12
#define CE 11
#define DC 10
#define DIN 9
#define CLK 8


char SmallFont[570] = {
0x00, 0x00, 0x00, 0x00, 0x00, 0x00,   // sp 32
0x00, 0x00, 0x00, 0x2f, 0x00, 0x00,   // !
0x00, 0x00, 0x07, 0x00, 0x07, 0x00,   // "
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0x00, 0x00, 0x06, 0x09, 0x09, 0x06    // ~ (Degrees)
};
unsigned char taab[6][84] = {

{  0,  0,  0,  0,  0,  0,  0,  0,  0,  0,  0,  0,  0,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  0,  0},
{  0,  0,  0,  0,  0,  0,  0,  0,  0,  0,  0,  0,  0,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  0,  0},
{  0,  0,  0,  0,  0,  0,  0,  0,  0,  0,  0,  0,  0,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  0,  0},
{  0,  0,  0,  0,  0,  0,  0,  0,  0,  0,  0,  0,  0,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  0,  0},
{  0,  0,  0,  0,  0,  0,  0,  0,  0,  0,  0,  0,  0,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  0,  0},
{  0,  0,  0,  0,  0,  0,  0,  0,  0,  0,  0,  0,  0,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  0,  0},
};




void LcdWriteCmd(byte cmd,int a)
{
     //DC pin is low for commands
    digitalWrite(DC, a);
    digitalWrite(CE, LOW);
    shiftOut(DIN, CLK, MSBFIRST, cmd); //transmit serial data
    digitalWrite(CE, HIGH);
}

void LcdWriteCmd(String cmd)
{
     //DC pin is low for commands
    digitalWrite(DC, 1);
    digitalWrite(CE, LOW);
    for(int i=0;i<8;i++)
    {
    digitalWrite(CLK,LOW);   
    digitalWrite(DIN,(cmd[i])-48); 
    digitalWrite(CLK,HIGH);     
    }
    digitalWrite(CE, HIGH);
}
void gotoxy(int x,int y)
{
    LcdWriteCmd(0x40+x,0); 
    LcdWriteCmd(0x80+y,0); 
}

void clearscr()
{
    LcdWriteCmd(0x40,0); 
    LcdWriteCmd(0x80,0); 
    for(int i=0;i<84*48;i++)
    LcdWriteCmd(0x00,1); 
       
}
void cleartaab()
{
    for(int y=0;y<6;y++)
        for(int x=0;x<84;x++)
            taab[y][x] = 0;
}

int a=0;


void frameupdate()
{
    for(int i=0;i<6*84;i++)
    {
        LcdWriteCmd(*(*(taab)+i),1); 
    }
  
}

void printchar(char a,int x,int y,bool color)
{
    int c = (a-32)*6;
    for(int n=0;n<6;n++)
    {   
        for(int m=0;m<8;m++)
        {  
            
            if((SmallFont[c+n] & (1 << m)) >> m)
                pixel(x+n,y+m,color);
               
        }
    }
}
void printstr(char *a,int x,int y,bool color)
{
    for(;*a!=0 && x<84;a++,x+=6)
        {
            printchar(*a,x,y,color);
        }
}

void setup()
{
    pinMode(RST, OUTPUT);
    pinMode(CE, OUTPUT);
    pinMode(DC, OUTPUT);
    pinMode(DIN, OUTPUT);
    pinMode(CLK, OUTPUT);
    pinMode(A0, OUTPUT);
    
    digitalWrite(RST, LOW);
    digitalWrite(RST, HIGH); 
    
    //do poprawnego dzialania musza byc ustawione WSZYSTKIE komendy konfiguracyjne, najpierw extended pozniej basic commands (ostatnia komenda ma byc ustawienie normalnego wyswietlania "normal display")
    LcdWriteCmd(0x21,0); // LCD extended commands
    LcdWriteCmd(0xb9,0); // set LCD Vop (contrast)
    LcdWriteCmd(0x04,0); // set temp coefficent
    LcdWriteCmd(0x14,0); // LCD bias mode 1:40
    LcdWriteCmd(0x20,0); // LCD basic commands
    
    LcdWriteCmd(0x0C,0); // normal display
    
    clearscr();

}
int aab = 0;

void line(int x1,int y1,int x2, int y2,bool color)
{
    int c,nextxa=0,nextya=0,nextxb=0,nextyb=0;
    double tg = 0;
    if(x1>x2)
    {
        c = x1;
        x1 = x2;
        x2 = c;
        c = y1;
        y1 = y2;
        y2 = c;
    }
    tg = (y1 - y2)/(double)(x2 - x1);
    if(tg>=1)
    {   
        nextya--; 
        nextxb++; 
        nextyb--;  
  
        return;
    }
    else if(tg < 1 && tg >=0)
    {
        nextxa++;
        nextya--;
        nextxb++;   
        Serial.println(2);  
    }
    else if(tg < 0 && tg >= -1)
    {
        nextxa++;
        nextxb++;  
        nextyb++;  
        Serial.println(3);
    }
    else if(tg <-1)
    {
        nextxa++;  
        nextya++; 
        nextyb++;
        Serial.println(4);
    }
    do
    {
        pixel(x1,y1,color);
        if(abs(((y1 + nextya - y2)/(double)(x2 - (x1 + nextxa))) - tg) > abs(((y1 + nextyb - y2)/(double)(x2 - (x1 + nextxb))) - tg))
        {
            x1 += nextxb;
            y1 += nextyb;
        }
        else
        {
            x1 += nextxa;
            y1 += nextya;
        }
    }while(x1<x2);
              
}



void pixel(int x,int y,bool color)
{
    if(color)
        taab[y/8][x] |= (1 << (y%8));   
    else
        taab[y/8][x] &= ~(1 << (y%8)); 
}

int xx=0,yy=0;
void loop()
{
  
   /* for(int i=0;i<570;i++)
    {  
       LcdWriteCmd(SmallFont[i],1);
       
       delay(10);
    }*/
    xx = random(84);
    yy = random(48);
  //  printstr("WELLCOME",xx,yy,true);
     // for(int x=0;x<83;x++)  
 //     {
        line(random(84),random(48),random(84),random(48),true);
        line(xx,yy,xx,yy,true);
        frameupdate();
        delay(200);
        cleartaab();
  //    }
    
}



































